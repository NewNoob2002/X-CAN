## boards/xcan/xcan_g431/Kconfig.xcan_g431
```kconfig
config BOARD_XCAN_G431
    select SOC_STM32G431XX
    select SOC_EARLY_RESET_HOOK
```

## boards/xcan/xcan_g431/board.yml
```yaml
board:
  name: xcan_g431
  full_name: X-CAN STM32G431RB
  vendor: others
  socs:
    - name: stm32g431xx
```

## legacy/zephyr/firmware/Kconfig
```kconfig
mainmenu "X-CAN"
source "Kconfig.zephyr"
config XCAN_USB
    bool "Vendor USB bringup protocol"
    default n
config XCAN_CAN
    bool "X-CAN v2 USB and FDCAN service"
    depends on XCAN_USB
    default n
config XCAN_INTERNAL_LOOPBACK
    bool "Internal CAN loopback with transceiver kept in standby"
    depends on XCAN_CAN
    default n
config XCAN_USB_VID
    hex "USB vendor ID"
    range 0x1 0xffff
    default 0xC0CA
config XCAN_USB_PID
    hex "USB product ID"
    range 0x1 0xffff
    default 0x0313
```

## west.yml
```yaml
manifest:
  projects:
    - name: zephyr
      url: https://github.com/zephyrproject-rtos/zephyr
      revision: 684c9e8f32e4373a21098559f748f06915f950c9
      import:
        name-allowlist: [cmsis_6, hal_stm32]
  self:
    path: x-can
```
