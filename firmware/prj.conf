## CMakeLists.txt
```
add_library(xcan_mcuboot_port STATIC boot/flash_map_backend.c)
target_include_directories(xcan_mcuboot_port PUBLIC boot/include)
target_link_libraries(xcan_mcuboot_port PUBLIC stm32cubemx)

add_library(xcan_app STATIC
    src/app.c
    src/fw_update.c
    src/protocol.c
    src/protocol_v2.c
    src/usb.c
    ${PROJECT_SOURCE_DIR}/Core/Src/early_reset.S
    ${PROJECT_SOURCE_DIR}/Core/Src/xcan_board.c
)
target_include_directories(xcan_app PUBLIC src PRIVATE boot/include)
set(XCAN_CONFIRM_DELAY_MS 1000 CACHE STRING "MCUboot test-image health confirmation delay")
target_compile_definitions(xcan_app PRIVATE XCAN_CONFIRM_DELAY_MS=${XCAN_CONFIRM_DELAY_MS})
target_link_libraries(xcan_app
    PUBLIC stm32cubemx
    PRIVATE cherryusb_device freertos_kernel mcuboot_bootutil tinycrypt xcan_mcuboot_port
)

set_target_properties(${CMAKE_PROJECT_NAME} PROPERTIES OUTPUT_NAME xcan)
target_compile_definitions(${CMAKE_PROJECT_NAME} PRIVATE
    USER_VECT_TAB_ADDRESS
    VECT_TAB_OFFSET=0x00006200U
)
target_link_options(${CMAKE_PROJECT_NAME} PRIVATE
    -T${PROJECT_SOURCE_DIR}/STM32G431XX_FLASH.ld
    -Wl,--defsym=__flash_origin=0x08006200
    -Wl,--defsym=__flash_length=0x0000BE00
    -Wl,-Map=${CMAKE_BINARY_DIR}/xcan.map
)
set_property(TARGET ${CMAKE_PROJECT_NAME} APPEND PROPERTY LINK_DEPENDS
    ${PROJECT_SOURCE_DIR}/STM32G431XX_FLASH.ld
)

find_package(Python3 REQUIRED COMPONENTS Interpreter)
set(XCAN_IMAGE_VERSION "0.1.0+0" CACHE STRING "MCUboot image version")
set(XCAN_SIGNING_KEY "$ENV{XCAN_SIGNING_KEY}" CACHE FILEPATH
    "ECDSA-P256 image signing key")
set(XCAN_SIGNING_KEY_USAGE "development" CACHE STRING
    "Signing key usage recorded in firmware metadata")
if(NOT XCAN_SIGNING_KEY)
    message(FATAL_ERROR "Set XCAN_SIGNING_KEY to an ECDSA-P256 private key outside the repository")
endif()
if(NOT EXISTS "${XCAN_SIGNING_KEY}")
    message(FATAL_ERROR "XCAN_SIGNING_KEY does not exist: ${XCAN_SIGNING_KEY}")
endif()

set(MCUBOOT_SCRIPTS ${PROJECT_SOURCE_DIR}/components/MCUboot/scripts)
set(MCUBOOT_PYTHONPATH ${MCUBOOT_SCRIPTS}:${MCUBOOT_SCRIPTS}/vendor)
set(MCUBOOT_PUBLIC_KEY_C ${CMAKE_BINARY_DIR}/generated/mcuboot_public_key.c)
add_custom_command(
    OUTPUT ${MCUBOOT_PUBLIC_KEY_C}
    COMMAND ${CMAKE_COMMAND} -E make_directory ${CMAKE_BINARY_DIR}/generated
    COMMAND ${CMAKE_COMMAND} -E env PYTHONPATH=${MCUBOOT_PYTHONPATH}
        ${Python3_EXECUTABLE} ${MCUBOOT_SCRIPTS}/imgtool.py getpub
        --key ${XCAN_SIGNING_KEY} --encoding lang-c --output ${MCUBOOT_PUBLIC_KEY_C}
    DEPENDS ${XCAN_SIGNING_KEY} ${MCUBOOT_SCRIPTS}/imgtool.py
    VERBATIM
)

add_executable(xcan_boot
    boot/main.c
    boot/keys.c
    ${MCUBOOT_PUBLIC_KEY_C}
    ${PROJECT_SOURCE_DIR}/startup_stm32g431xx.s
    ${PROJECT_SOURCE_DIR}/Core/Src/early_reset.S
    ${PROJECT_SOURCE_DIR}/Core/Src/system_stm32g4xx.c
    ${PROJECT_SOURCE_DIR}/Drivers/STM32G4xx_HAL_Driver/Src/stm32g4xx_hal_flash.c
    ${PROJECT_SOURCE_DIR}/Drivers/STM32G4xx_HAL_Driver/Src/stm32g4xx_hal_flash_ex.c
)
set_target_properties(xcan_boot PROPERTIES
    SUFFIX ".elf"
    RUNTIME_OUTPUT_DIRECTORY ${CMAKE_BINARY_DIR}
)
target_include_directories(xcan_boot PRIVATE boot/include)
target_link_libraries(xcan_boot PRIVATE mcuboot_bootutil xcan_mcuboot_port
    stm32cubemx m)
target_link_options(xcan_boot PRIVATE
    -T${PROJECT_SOURCE_DIR}/STM32G431XX_FLASH.ld
    -Wl,--defsym=__flash_origin=0x08000000
    -Wl,--defsym=__flash_length=0x00006000
    -Wl,-Map=${CMAKE_BINARY_DIR}/xcan_boot.map
)
set_property(TARGET xcan_boot APPEND PROPERTY LINK_DEPENDS
    ${PROJECT_SOURCE_DIR}/STM32G431XX_FLASH.ld
)

add_custom_target(xcan_artifacts ALL
    COMMAND ${CMAKE_OBJCOPY} -O binary $<TARGET_FILE:${CMAKE_PROJECT_NAME}> ${CMAKE_BINARY_DIR}/xcan.bin
    COMMAND ${CMAKE_OBJCOPY} -O ihex $<TARGET_FILE:${CMAKE_PROJECT_NAME}> ${CMAKE_BINARY_DIR}/xcan.hex
    COMMAND ${CMAKE_SIZE} $<TARGET_FILE:${CMAKE_PROJECT_NAME}>
    COMMAND ${CMAKE_OBJCOPY} -O binary $<TARGET_FILE:xcan_boot> ${CMAKE_BINARY_DIR}/xcan_boot.bin
    COMMAND ${CMAKE_OBJCOPY} -O ihex $<TARGET_FILE:xcan_boot> ${CMAKE_BINARY_DIR}/xcan_boot.hex
    COMMAND ${CMAKE_SIZE} $<TARGET_FILE:xcan_boot>
    COMMAND ${CMAKE_COMMAND} -E env PYTHONPATH=${MCUBOOT_PYTHONPATH}
        ${Python3_EXECUTABLE} ${MCUBOOT_SCRIPTS}/imgtool.py sign
        --key ${XCAN_SIGNING_KEY} --align 8 --max-align 8
        --header-size 0x200 --slot-size 0xD000 --max-sectors 26
        --version ${XCAN_IMAGE_VERSION} --pad-header
        ${CMAKE_BINARY_DIR}/xcan.bin ${CMAKE_BINARY_DIR}/xcan.signed.bin
    COMMAND ${CMAKE_COMMAND} -E env PYTHONPATH=${MCUBOOT_PYTHONPATH}
        ${Python3_EXECUTABLE} ${MCUBOOT_SCRIPTS}/imgtool.py verify
        --key ${XCAN_SIGNING_KEY} ${CMAKE_BINARY_DIR}/xcan.signed.bin
    COMMAND ${Python3_EXECUTABLE} ${PROJECT_SOURCE_DIR}/tools/package_firmware.py
        --boot ${CMAKE_BINARY_DIR}/xcan_boot.bin
        --app ${CMAKE_BINARY_DIR}/xcan.bin
        --signed ${CMAKE_BINARY_DIR}/xcan.signed.bin
        --factory ${CMAKE_BINARY_DIR}/xcan_factory.bin
        --metadata ${CMAKE_BINARY_DIR}/firmware-metadata.json
        --version ${XCAN_IMAGE_VERSION}
        --key-usage ${XCAN_SIGNING_KEY_USAGE}
    DEPENDS ${CMAKE_PROJECT_NAME} xcan_boot
    BYPRODUCTS
        ${CMAKE_BINARY_DIR}/xcan.bin
        ${CMAKE_BINARY_DIR}/xcan.hex
        ${CMAKE_BINARY_DIR}/xcan_boot.bin
        ${CMAKE_BINARY_DIR}/xcan_boot.hex
        ${CMAKE_BINARY_DIR}/xcan.signed.bin
        ${CMAKE_BINARY_DIR}/xcan_factory.bin
        ${CMAKE_BINARY_DIR}/firmware-metadata.json
    VERBATIM
)
```

## Kconfig
```
mainmenu "X-CAN"
source "Kconfig.zephyr"
config XCAN_USB
    bool "Vendor USB bringup protocol"
    default n
config XCAN_USB_VID
    hex "USB vendor ID"
    range 0x1 0xffff
    default 0xC0CA
config XCAN_USB_PID
    hex "USB product ID"
    range 0x1 0xffff
    default 0x0313
```

## prj.conf
```kconfig
CONFIG_GPIO=y
CONFIG_SERIAL=y
CONFIG_CONSOLE=y
CONFIG_UART_CONSOLE=y
CONFIG_PRINTK=y
CONFIG_MAIN_STACK_SIZE=2048
CONFIG_SYSTEM_WORKQUEUE_STACK_SIZE=1024
CONFIG_ASSERT=y
CONFIG_HWINFO=y
CONFIG_BUILD_OUTPUT_BIN=y
CONFIG_BUILD_OUTPUT_HEX=y
CONFIG_BOOT_BANNER=n
```

## src/main.c
```c
/* SPDX-License-Identifier: Apache-2.0 */
#include <soc.h>
#include <zephyr/drivers/gpio.h>
#include <zephyr/kernel.h>
#include <zephyr/sys/atomic.h>
#include <zephyr/sys/printk.h>

static atomic_t termination = ATOMIC_INIT(-1);
int xcan_termination_get(void) { return (int)atomic_get(&termination); }
#ifdef CONFIG_XCAN_USB
int xcan_usb_init(void);
#endif

#define USER DT_PATH(zephyr_user)
static const struct gpio_dt_spec stb = GPIO_DT_SPEC_GET(USER, stb_gpios);
static const struct gpio_dt_spec arm = GPIO_DT_SPEC_GET(USER, arm_gpios);
static const struct gpio_dt_spec injection =
    GPIO_DT_SPEC_GET(USER, injection_gpios);
static const struct gpio_dt_spec tx = GPIO_DT_SPEC_GET(USER, can_tx_gpios);
static const struct gpio_dt_spec term =
    GPIO_DT_SPEC_GET(USER, termination_gpios);
static const struct gpio_dt_spec led = GPIO_DT_SPEC_GET(DT_ALIAS(led0), gpios);

static void configure(const struct gpio_dt_spec *pin, gpio_flags_t flags) {
  if (!gpio_is_ready_dt(pin) || gpio_pin_configure_dt(pin, flags) != 0) {
    printk("FATAL gpio init\n");
    k_panic();
  }
}

int main(void) {
  /* Configure the output latch before enabling each output. */
  configure(&arm, GPIO_OUTPUT_INACTIVE);
  configure(&stb, GPIO_OUTPUT_ACTIVE);
  configure(&injection, GPIO_OUTPUT_INACTIVE);
  configure(&tx, GPIO_OUTPUT_ACTIVE);
  configure(&term,
            GPIO_INPUT); /* External R14 pull-down, manual declaration. */
  configure(&led, GPIO_OUTPUT_INACTIVE);
  printk("X-CAN bringup sysclk=%u idcode=%08x optr=%08x SAFE\n",
         SystemCoreClock, DBGMCU->IDCODE, FLASH->OPTR);
#ifdef CONFIG_XCAN_USB
  int usb_err = xcan_usb_init();
  printk("USB init=%d vid=%04x pid=%04x\n", usb_err, CONFIG_XCAN_USB_VID,
         CONFIG_XCAN_USB_PID);
  if (usb_err != 0) {
    k_panic();
  }
#endif

  int stable = -1, candidate = -1;
  unsigned int samples = 0;
  int64_t heartbeat = 0;
  while (true) {
    int value = gpio_pin_get_dt(&term);
    if (value < 0) {
      printk("FATAL termination read=%d\n", value);
      k_panic();
    }
    if (value != candidate) {
      candidate = value;
      samples = 1;
    } else if (samples < 4) {
      samples++;
    }
    if (samples == 4 && stable != candidate) {
      stable = candidate;
      atomic_set(&termination, stable);
      printk("termination_declared=%d (manual switch)\n", stable);
    }
    if (k_uptime_get() >= heartbeat) {
      printk("alive ms=%lld termination_declared=%d SAFE\n",
             (long long)k_uptime_get(), stable);
      if (gpio_pin_toggle_dt(&led) != 0) {
        k_panic();
      }
      heartbeat = k_uptime_get() + 1000;
    }
    k_msleep(10);
  }
  return 0;
}
```

## src/app.c
```c
/* SPDX-License-Identifier: Apache-2.0 */
#include "app.h"
#include "FreeRTOS.h"
#include "bootutil/bootutil_public.h"
#include "main.h"
#include "task.h"
#include "xcan_board.h"
#include <stdio.h>

#ifndef XCAN_CONFIRM_DELAY_MS
#define XCAN_CONFIRM_DELAY_MS 1000U
#endif

static volatile int termination = -1;
static volatile bool update_ready;
static TaskHandle_t usb_task;
static StaticTask_t main_tcb, usb_tcb, idle_tcb;
static StackType_t main_stack[512], usb_stack[384], idle_stack[128];

void vApplicationStackOverflowHook(TaskHandle_t task, char *name) {
  (void)task;
  (void)name;
  xcan_fatal();
}
void vApplicationGetIdleTaskMemory(StaticTask_t **tcb, StackType_t **stack,
                                   uint32_t *size) {
  *tcb = &idle_tcb;
  *stack = idle_stack;
  *size = 128;
}
void usb_lock(void) { taskENTER_CRITICAL(); }
void usb_unlock(void) { taskEXIT_CRITICAL(); }
void usb_wake(void) {
  BaseType_t wake = pdFALSE;
  vTaskNotifyGiveFromISR(usb_task, &wake);
  portYIELD_FROM_ISR(wake);
}
uint32_t uptime_ms(void) { return xTaskGetTickCount(); }
int termination_get(void) { return termination; }
int xcan_boot_request_test(void) { return boot_set_pending_multi(0, 0); }
int xcan_boot_confirm(void) { return boot_set_confirmed_multi(0); }
bool xcan_update_ready(void) { return update_ready; }
void xcan_reboot(void) {
  NVIC_SystemReset();
  for (;;) {
  }
}
static void usb_thread(void *arg) {
  (void)arg;
  for (;;) {
    ulTaskNotifyTake(pdTRUE, portMAX_DELAY);
    usb_work();
  }
}
static void main_thread(void *arg) {
  (void)arg;
  char line[128];
  snprintf(line, sizeof(line),
           "X-CAN HAL+FreeRTOS sysclk=%lu idcode=%08lx optr=%08lx SAFE\n",
           (unsigned long)SystemCoreClock, (unsigned long)board_id(),
           (unsigned long)FLASH->OPTR);
  xcan_log(line);
  uint32_t uid[3] = {HAL_GetUIDw0(), HAL_GetUIDw1(), HAL_GetUIDw2()};
  int err = usb_init(uid);
  snprintf(line, sizeof(line), "USB init=%d vid=c0ca pid=0313\n", err);
  xcan_log(line);
  if (err)
    xcan_fatal();
  int candidate = -1;
  unsigned samples = 0;
  uint32_t heartbeat = 0;
  int image_confirmed = 0;
  for (;;) {
    int value = HAL_GPIO_ReadPin(TERM_DECLARED_GPIO_Port, TERM_DECLARED_Pin) ==
                GPIO_PIN_SET;
    if (value != candidate) {
      candidate = value;
      samples = 1;
    } else if (samples < 4)
      samples++;
    if (samples == 4 && termination != candidate) {
      termination = candidate;
      snprintf(line, sizeof(line), "termination_declared=%d (manual switch)\n",
               termination);
      xcan_log(line);
    }
    uint32_t now = uptime_ms();
    if (!image_confirmed && now >= pdMS_TO_TICKS(XCAN_CONFIRM_DELAY_MS)) {
      int confirm = xcan_boot_confirm();
      snprintf(line, sizeof(line), "MCUboot confirm=%d\n", confirm);
      xcan_log(line);
      if (confirm != 0)
        xcan_fatal();
      update_ready = true;
      image_confirmed = 1;
    }
    if ((int32_t)(now - heartbeat) >= 0) {
      snprintf(line, sizeof(line),
               "alive ms=%lu hal_ms=%lu termination_declared=%d SAFE\n",
               (unsigned long)now, (unsigned long)HAL_GetTick(), termination);
      xcan_log(line);
      HAL_GPIO_TogglePin(HEARTBEAT_LED_GPIO_Port, HEARTBEAT_LED_Pin);
      heartbeat = now + 1000;
    }
    vTaskDelay(pdMS_TO_TICKS(10));
  }
}
void xcan_start(void) {
  usb_task =
      xTaskCreateStatic(usb_thread, "usb", 384, NULL, 2, usb_stack, &usb_tcb);
  configASSERT(usb_task);
  configASSERT(xTaskCreateStatic(main_thread, "main", 512, NULL, 1, main_stack,
                                 &main_tcb));
  vTaskStartScheduler();
  xcan_fatal();
}
```

## src/app.h
```c
#pragma once
#include <stdbool.h>
#include <stdint.h>
void usb_wake(void);
void usb_lock(void);
void usb_unlock(void);
uint32_t board_id(void);
uint32_t uptime_ms(void);
int termination_get(void);
int xcan_boot_request_test(void);
int xcan_boot_confirm(void);
bool xcan_update_ready(void);
void xcan_reboot(void);
void usb_work(void);
int usb_init(const uint32_t uid[3]);
```

## src/fw_update.c
```c
/* SPDX-License-Identifier: Apache-2.0 */
#include "fw_update.h"
#include "app.h"
#include "boot_memory_map.h"
#include <bootutil/image.h>
#include <flash_map_backend/flash_map_backend.h>
#include <string.h>
#include <tinycrypt/sha256.h>

static struct {
    struct xcan_fw_status status;
    uint8_t expected_hash[XCAN_FW_HASH_SIZE];
    uint8_t buffer[XCAN_FW_CHUNK_MAX];
} update;

static int fail(enum xcan_fw_error error)
{
    update.status.state = XCAN_FW_ERROR;
    update.status.error = error;
    return -(int)error;
}

void xcan_fw_reset(void) { memset(&update, 0, sizeof(update)); }

int xcan_fw_begin(uint32_t image_size, const uint8_t hash[XCAN_FW_HASH_SIZE])
{
    if (hash == NULL || image_size < XCAN_IMAGE_HEADER_SIZE + 8u ||
        image_size > XCAN_SIGNED_IMAGE_MAX)
        return -(int)XCAN_FW_ERROR_ARGUMENT;
    if (update.status.state == XCAN_FW_ERASING ||
        update.status.state == XCAN_FW_READY ||
        update.status.state == XCAN_FW_RECEIVING) {
        return update.status.image_size == image_size &&
                       memcmp(update.expected_hash, hash, XCAN_FW_HASH_SIZE) == 0
                   ? 0
                   : -(int)XCAN_FW_ERROR_STATE;
    }
    memset(&update, 0, sizeof(update));
    update.status.state = XCAN_FW_ERASING;
    update.status.image_size = image_size;
    memcpy(update.expected_hash, hash, XCAN_FW_HASH_SIZE);
    const struct flash_area *area;
    if (flash_area_open(FLASH_AREA_ID_SECONDARY, &area) != 0)
        return fail(XCAN_FW_ERROR_IO);
    int result = flash_area_erase(area, XCAN_SECONDARY_SIZE - XCAN_FLASH_PAGE_SIZE,
                                  XCAN_FLASH_PAGE_SIZE);
    flash_area_close(area);
    if (result != 0)
        return fail(XCAN_FW_ERROR_IO);
    update.status.erase_offset = XCAN_FLASH_PAGE_SIZE;
    return 0;
}

void xcan_fw_step(void)
{
    if (update.status.state != XCAN_FW_ERASING)
        return;
    const struct flash_area *area;
    if (flash_area_open(FLASH_AREA_ID_SECONDARY, &area) != 0) {
        fail(XCAN_FW_ERROR_IO);
        return;
    }
    int result = flash_area_erase(area, update.status.erase_offset - XCAN_FLASH_PAGE_SIZE,
                                  XCAN_FLASH_PAGE_SIZE);
    flash_area_close(area);
    if (result != 0) {
        fail(XCAN_FW_ERROR_IO);
        return;
    }
    update.status.erase_offset += XCAN_FLASH_PAGE_SIZE;
    if (update.status.erase_offset == XCAN_SECONDARY_SIZE)
        update.status.state = XCAN_FW_READY;
}

int xcan_fw_write(uint32_t offset, const uint8_t *data, size_t length)
{
    if (data == NULL || length == 0 || length > XCAN_FW_CHUNK_MAX ||
        offset % XCAN_FLASH_WRITE_SIZE != 0 ||
        offset > update.status.image_size ||
        length > update.status.image_size - offset ||
        (length % XCAN_FLASH_WRITE_SIZE != 0 &&
         offset + length != update.status.image_size))
        return -(int)XCAN_FW_ERROR_ARGUMENT;
    if (update.status.state == XCAN_FW_ERASING)
        return -(int)XCAN_FW_ERROR_STATE;
    if (update.status.state != XCAN_FW_READY &&
        update.status.state != XCAN_FW_RECEIVING)
        return -(int)XCAN_FW_ERROR_STATE;

    const struct flash_area *area;
    if (flash_area_open(FLASH_AREA_ID_SECONDARY, &area) != 0)
        return fail(XCAN_FW_ERROR_IO);
    uint32_t area_offset = XCAN_FLASH_PAGE_SIZE + offset;
    if (offset < update.status.next_offset) {
        int result = offset + length <= update.status.next_offset &&
                             flash_area_read(area, area_offset, update.buffer, length) == 0 &&
                             memcmp(update.buffer, data, length) == 0
                         ? 0
                         : -(int)XCAN_FW_ERROR_STATE;
        flash_area_close(area);
        return result;
    }
    if (offset != update.status.next_offset) {
        flash_area_close(area);
        return -(int)XCAN_FW_ERROR_STATE;
    }

    size_t programmed = (length + XCAN_FLASH_WRITE_SIZE - 1u) &
                        ~(size_t)(XCAN_FLASH_WRITE_SIZE - 1u);
    memset(update.buffer, 0xff, programmed);
    memcpy(update.buffer, data, length);
    int result = flash_area_write(area, area_offset, update.buffer, programmed);
    flash_area_close(area);
    if (result != 0)
        return fail(XCAN_FW_ERROR_IO);
    update.status.next_offset += length;
    update.status.state = XCAN_FW_RECEIVING;
    return 0;
}

int xcan_fw_finish(void)
{
    if (update.status.state != XCAN_FW_RECEIVING ||
        update.status.next_offset != update.status.image_size)
        return -(int)XCAN_FW_ERROR_STATE;
    const struct flash_area *area;
    uint32_t magic;
    if (flash_area_open(FLASH_AREA_ID_SECONDARY, &area) != 0)
        return fail(XCAN_FW_ERROR_IO);
    if (flash_area_read(area, XCAN_FLASH_PAGE_SIZE, &magic, sizeof(magic)) != 0) {
        flash_area_close(area);
        return fail(XCAN_FW_ERROR_IO);
    }
    if (magic != IMAGE_MAGIC) {
        flash_area_close(area);
        return fail(XCAN_FW_ERROR_MAGIC);
    }

    struct tc_sha256_state_struct sha;
    uint8_t digest[XCAN_FW_HASH_SIZE];
    if (!tc_sha256_init(&sha)) {
        flash_area_close(area);
        return fail(XCAN_FW_ERROR_IO);
    }
    uint32_t offset = 0;
    while (offset < update.status.image_size) {
        size_t length = update.status.image_size - offset;
        if (length > sizeof(update.buffer))
            length = sizeof(update.buffer);
        if (flash_area_read(area, XCAN_FLASH_PAGE_SIZE + offset, update.buffer, length) != 0 ||
            !tc_sha256_update(&sha, update.buffer, length)) {
            flash_area_close(area);
            return fail(XCAN_FW_ERROR_IO);
        }
        offset += length;
    }
    flash_area_close(area);
    if (!tc_sha256_final(digest, &sha))
        return fail(XCAN_FW_ERROR_IO);
    if (memcmp(digest, update.expected_hash, sizeof(digest)) != 0)
        return fail(XCAN_FW_ERROR_HASH);
    if (xcan_boot_request_test() != 0)
        return fail(XCAN_FW_ERROR_PENDING);
    update.status.state = XCAN_FW_COMPLETE;
    update.status.error = XCAN_FW_ERROR_NONE;
    return 0;
}

int xcan_fw_abort(void)
{
    if (update.status.state == XCAN_FW_COMPLETE)
        return -(int)XCAN_FW_ERROR_STATE;
    xcan_fw_reset();
    return 0;
}

void xcan_fw_get_status(struct xcan_fw_status *status)
{
    if (status != NULL)
        *status = update.status;
}

bool xcan_fw_complete(void) { return update.status.state == XCAN_FW_COMPLETE; }
```

## src/fw_update.h
```c
/* SPDX-License-Identifier: Apache-2.0 */
#ifndef XCAN_FW_UPDATE_H
#define XCAN_FW_UPDATE_H
#include <stdbool.h>
#include <stddef.h>
#include <stdint.h>

#define XCAN_FW_CHUNK_MAX 512u
#define XCAN_FW_HASH_SIZE 32u

enum xcan_fw_state {
    XCAN_FW_IDLE,
    XCAN_FW_ERASING,
    XCAN_FW_READY,
    XCAN_FW_RECEIVING,
    XCAN_FW_COMPLETE,
    XCAN_FW_ERROR,
};

enum xcan_fw_error {
    XCAN_FW_ERROR_NONE,
    XCAN_FW_ERROR_ARGUMENT,
    XCAN_FW_ERROR_STATE,
    XCAN_FW_ERROR_IO,
    XCAN_FW_ERROR_MAGIC,
    XCAN_FW_ERROR_HASH,
    XCAN_FW_ERROR_PENDING,
};

struct xcan_fw_status {
    uint8_t state, error;
    uint32_t image_size, next_offset, erase_offset;
};

void xcan_fw_reset(void);
int xcan_fw_begin(uint32_t image_size, const uint8_t hash[XCAN_FW_HASH_SIZE]);
void xcan_fw_step(void);
int xcan_fw_write(uint32_t offset, const uint8_t *data, size_t length);
int xcan_fw_finish(void);
int xcan_fw_abort(void);
void xcan_fw_get_status(struct xcan_fw_status *status);
bool xcan_fw_complete(void);

#endif
```

## src/msos.h
```c
/* SPDX-License-Identifier: Apache-2.0
 * Adapted from Zephyr webusb/msosv2.h, Copyright (c) 2016-2019 Intel Corporation,
 * Copyright (c) 2023-2024 Nordic Semiconductor ASA.
 */
#include <zephyr/usb/msos_desc.h>
static const struct {
    struct msosv2_descriptor_set_header header;
    struct msosv2_compatible_id compatible;
    struct msosv2_guids_property property;
} __packed msos_set = {
    .header = { .wLength = 10, .wDescriptorType = MS_OS_20_SET_HEADER_DESCRIPTOR,
        .dwWindowsVersion = sys_cpu_to_le32(0x0A000000), .wTotalLength = 162 },
    .compatible = { .wLength = 20, .wDescriptorType = MS_OS_20_FEATURE_COMPATIBLE_ID,
        .CompatibleID = {'W','I','N','U','S','B',0,0} },
    .property = { .wLength = 132, .wDescriptorType = MS_OS_20_FEATURE_REG_PROPERTY,
        .wPropertyDataType = MS_OS_20_PROPERTY_DATA_REG_MULTI_SZ,
        .wPropertyNameLength = 42, .PropertyName = {DEVICE_INTERFACE_GUIDS_PROPERTY_NAME},
        .wPropertyDataLength = 80, .bPropertyData = {0x7b, 0x00, 0x44, 0x00, 0x39, 0x00, 0x45, 0x00, 0x37, 0x00, 0x31, 0x00, 0x44, 0x00, 0x41, 0x00, 0x38, 0x00, 0x2d, 0x00, 0x33, 0x00, 0x43, 0x00, 0x42, 0x00, 0x35, 0x00, 0x2d, 0x00, 0x34, 0x00, 0x45, 0x00, 0x33, 0x00, 0x42, 0x00, 0x2d, 0x00, 0x38, 0x00, 0x41, 0x00, 0x35, 0x00, 0x33, 0x00, 0x2d, 0x00, 0x35, 0x00, 0x38, 0x00, 0x34, 0x00, 0x33, 0x00, 0x34, 0x00, 0x31, 0x00, 0x34, 0x00, 0x45, 0x00, 0x30, 0x00, 0x30, 0x00, 0x30, 0x00, 0x31, 0x00, 0x7d, 0x00, 0x00, 0x00, 0x00, 0x00} },
};
BUILD_ASSERT(sizeof(msos_set) == 162);
static const struct {
    struct usb_bos_platform_descriptor platform;
    struct usb_bos_capability_msos capability;
} __packed msos_cap = {
    .platform = { .bLength = 28, .bDescriptorType = USB_DESC_DEVICE_CAPABILITY,
        .bDevCapabilityType = USB_BOS_CAPABILITY_PLATFORM,
        .PlatformCapabilityUUID = {0xdf,0x60,0xdd,0xd8,0x89,0x45,0xc7,0x4c,
                                   0x9c,0xd2,0x65,0x9d,0x9e,0x64,0x8a,0x9f} },
    .capability = { .dwWindowsVersion = sys_cpu_to_le32(0x0A000000),
        .wMSOSDescriptorSetTotalLength = sys_cpu_to_le16(sizeof(msos_set)),
        .bMS_VendorCode = 2 },
};
static int msos_request(const struct usbd_context *ctx,
                        const struct usb_setup_packet *setup, struct net_buf *buf)
{
    ARG_UNUSED(ctx);
    if (setup->bmRequestType != 0xc0 || setup->bRequest != 2 ||
        setup->wIndex != MS_OS_20_DESCRIPTOR_INDEX || setup->wValue != 0) {
        return -ENOTSUP;
    }
    net_buf_add_mem(buf, &msos_set, MIN(net_buf_tailroom(buf), sizeof(msos_set)));
    return 0;
}
USBD_DESC_BOS_VREQ_DEFINE(bos_msos, sizeof(msos_cap), &msos_cap, 2, msos_request, NULL);
```

## src/msos_bytes.h
```c
/* SPDX-License-Identifier: Apache-2.0; same descriptor as firmware/src/msos.h */
static const uint8_t msos_bytes[] = {
0xa,0x0,0x0,0x0,0x0,0x0,0x0,0xa,0xa2,0x0,0x14,0x0,0x3,0x0,0x57,0x49,0x4e,0x55,0x53,0x42,0x0,0x0,0x0,0x0,0x0,0x0,0x0,0x0,0x0,0x0,0x84,0x0,0x4,0x0,0x7,0x0,0x2a,0x0,0x44,0x0,0x65,0x0,0x76,0x0,0x69,0x0,0x63,0x0,0x65,0x0,0x49,0x0,0x6e,0x0,0x74,0x0,0x65,0x0,0x72,0x0,0x66,0x0,0x61,0x0,0x63,0x0,0x65,0x0,0x47,0x0,0x55,0x0,0x49,0x0,0x44,0x0,0x73,0x0,0x0,0x0,0x50,0x0,0x7b,0x0,0x44,0x0,0x39,0x0,0x45,0x0,0x37,0x0,0x31,0x0,0x44,0x0,0x41,0x0,0x38,0x0,0x2d,0x0,0x33,0x0,0x43,0x0,0x42,0x0,0x35,0x0,0x2d,0x0,0x34,0x0,0x45,0x0,0x33,0x0,0x42,0x0,0x2d,0x0,0x38,0x0,0x41,0x0,0x35,0x0,0x33,0x0,0x2d,0x0,0x35,0x0,0x38,0x0,0x34,0x0,0x33,0x0,0x34,0x0,0x31,0x0,0x34,0x0,0x45,0x0,0x30,0x0,0x30,0x0,0x30,0x0,0x31,0x0,0x7d,0x0,0x0,0x0,0x0,0x0
};
_Static_assert(sizeof(msos_bytes) == 162, "MSOS size");
```

## src/protocol.c
```c
/* SPDX-License-Identifier: Apache-2.0 */
#include "protocol.h"
#include <string.h>

static void put32(uint8_t *p, uint32_t value)
{
    for (unsigned int i = 0; i < 4; ++i) { p[i] = (uint8_t)(value >> (8 * i)); }
}

void xcan_reply(const uint8_t request[64], uint8_t response[64],
                uint32_t clock_hz, uint32_t idcode, uint32_t uptime_ms, int term)
{
    memset(response, 0, 64);
    memcpy(response, "XCAN", 4);
    response[4] = 1;
    response[5] = request[5];
    memcpy(response + 8, request + 8, 4);
    if (memcmp(request, "XCAN", 4) || request[4] != 1 ||
        request[6] != 0 || request[7] > XCAN_PAYLOAD_SIZE) {
        response[6] = 1; /* Malformed header/version/length. */
        return;
    }
    if (request[5] == 1 && request[7] == 0) {
        response[7] = 14;
        put32(response + 12, clock_hz);
        put32(response + 16, idcode);
        put32(response + 20, uptime_ms);
        response[24] = term < 0 ? 0xff : (uint8_t)term;
        response[25] = 1; /* SAFE, no CAN or injection commands implemented. */
    } else if (request[5] == 2) {
        response[7] = request[7];
        memcpy(response + 12, request + 12, request[7]);
    } else {
        response[6] = 2; /* Unsupported command or arguments. */
    }
}
```

## src/protocol.h
```c
/* SPDX-License-Identifier: Apache-2.0 */
#ifndef XCAN_PROTOCOL_H
#define XCAN_PROTOCOL_H
#include <stdint.h>
#define XCAN_FRAME_SIZE 64
#define XCAN_PAYLOAD_SIZE 52
/* Fixed 64-byte records: XCAN, version, opcode, status, length, LE32 id, payload. */
void xcan_reply(const uint8_t request[64], uint8_t response[64],
                uint32_t clock_hz, uint32_t idcode, uint32_t uptime_ms, int term);
#endif
```

## src/protocol_v2.c
```c
/* SPDX-License-Identifier: Apache-2.0 */
#include "protocol_v2.h"
#include <string.h>

static uint16_t u16(const uint8_t *p) { return (uint16_t)p[0] | (uint16_t)p[1] << 8; }
static uint32_t u32(const uint8_t *p)
{
    return (uint32_t)p[0] | (uint32_t)p[1] << 8 | (uint32_t)p[2] << 16 | (uint32_t)p[3] << 24;
}
static void put(uint8_t *p, uint64_t value, size_t n)
{
    for (size_t i = 0; i < n; ++i) { p[i] = (uint8_t)(value >> (8 * i)); }
}
static bool zero(const uint8_t *p, size_t n)
{
    for (size_t i = 0; i < n; ++i) { if (p[i]) { return false; } }
    return true;
}

static bool envelope(const struct xcan_v2_message *m)
{
    if (m->length > XCAN_V2_MAX_PAYLOAD || m->kind < 1 || m->kind > 3) { return false; }
    if (m->kind == XCAN_V2_EVENT) {
        return m->opcode >= 0x8000 && m->id == 0 && m->session != 0 && m->status == 0;
    }
    if (m->opcode == 0 || m->opcode >= 0x8000 || m->id == 0 || m->sequence != 0) { return false; }
    if (m->kind == XCAN_V2_REQUEST && m->status != 0) { return false; }
    if (m->status > 6 || (m->status && m->length)) { return false; }
    if (m->opcode == XCAN_V2_HELLO) {
        return (m->kind == XCAN_V2_REQUEST || m->status) ? m->session == 0 : m->session != 0;
    }
    return m->session != 0;
}

/* CAN record = channel, flags, id, timestamp, sequence, DLC, data length, reserved, data. */
static size_t frame(const uint8_t *p, size_t n, bool tx)
{
    static const uint8_t fd_lengths[16] = {0,1,2,3,4,5,6,7,8,12,16,20,24,32,48,64};
    if (n < 24) { return 0; }
    uint16_t flags = u16(p + 2);
    uint32_t id = u32(p + 4);
    uint8_t dlc = p[20], len = p[21];
    bool extended = flags & 1, rtr = flags & 2, fd = flags & 4;
    if (p[0] || p[1] || (flags & ~31u) || !zero(p + 22, 2) ||
        id > (extended ? 0x1fffffffu : 0x7ffu) || dlc > 15 || len > 64 || n < 24u + len) { return 0; }
    if ((!fd && (dlc > 8 || (flags & 24))) || (fd && rtr)) { return 0; }
    if (len != (rtr ? 0 : fd_lengths[dlc])) { return 0; }
    if (tx && ((flags & 16) || !zero(p + 8, 12))) { return 0; }
    return 24u + len;
}

static bool state(const uint8_t *p, size_t n)
{
    return n == 40 && p[0] <= 4 && p[1] <= 1 &&
           (p[2] <= 1 || p[2] == 255) && p[3] == 0;
}

size_t xcan_v2_frame_encode(const struct xcan_v2_can_frame *f, bool tx,
                            uint8_t *wire, size_t capacity)
{
    if (f->length > 64 || capacity < 24u + f->length) { return 0; }
    uint8_t record[88] = {0};
    put(record + 2, f->flags, 2); put(record + 4, f->id, 4);
    put(record + 8, f->timestamp_us, 8); put(record + 16, f->sequence, 4);
    record[20] = f->dlc; record[21] = f->length;
    memcpy(record + 24, f->data, f->length);
    size_t n = frame(record, 24u + f->length, tx);
    if (n) { memcpy(wire, record, n); }
    return n;
}

size_t xcan_v2_frame_decode(const uint8_t *wire, size_t n, bool tx,
                            struct xcan_v2_can_frame *f)
{
    size_t size = frame(wire, n, tx);
    if (!size) { return 0; }
    f->flags = u16(wire + 2); f->id = u32(wire + 4); f->sequence = u32(wire + 16);
    f->timestamp_us = (uint64_t)u32(wire + 8) | (uint64_t)u32(wire + 12) << 32;
    f->dlc = wire[20]; f->length = wire[21];
    memset(f->data, 0, sizeof(f->data));
    memcpy(f->data, wire + 24, f->length);
    return size;
}

bool xcan_v2_valid(const struct xcan_v2_message *m)
{
    if (!envelope(m)) { return false; }
    const uint8_t *p = m->payload;
    size_t n = m->length;
    if (m->status) { return true; }
    if (m->kind == XCAN_V2_REQUEST) {
        switch (m->opcode) {
        case XCAN_V2_HELLO: case XCAN_V2_STATUS: case XCAN_V2_START: case XCAN_V2_STOP:
        case XCAN_V2_FW_STATUS: case XCAN_V2_FW_FINISH:
        case XCAN_V2_FW_ABORT: case XCAN_V2_FW_REBOOT:
            return n == 0;
        case XCAN_V2_CONFIGURE:
            return n == 12 && u32(p) != 0 && p[8] <= 1 && p[9] <= 1 && zero(p + 10, 2) &&
                   (p[9] ? u32(p + 4) != 0 : u32(p + 4) == 0);
        case XCAN_V2_SEND: return n != 0 && frame(p, n, true) == n;
        case XCAN_V2_FW_BEGIN:
            return n == 36 && u32(p) >= 520 && u32(p) <= 0xc000;
        case XCAN_V2_FW_WRITE:
            return n >= 9 && n <= 520 && u16(p + 4) == n - 8 &&
                   u16(p + 4) <= 512 && zero(p + 6, 2) &&
                   (u32(p) & 7u) == 0;
        default: return true; /* Bounded unknown request: dispatcher replies UNSUPPORTED. */
        }
    }
    if (m->kind == XCAN_V2_RESPONSE) {
        switch (m->opcode) {
        case XCAN_V2_HELLO:
            return n == 16 && !(u32(p) & ~31u) && u16(p + 4) == XCAN_V2_MAX_MESSAGE &&
                   p[6] == 1 && p[7] <= 2 && u32(p + 8) == 1000000 && zero(p + 12, 4);
        case XCAN_V2_STATUS: return state(p, n);
        case XCAN_V2_START: return n == 4 && u32(p) != 0;
        case XCAN_V2_CONFIGURE: case XCAN_V2_STOP: case XCAN_V2_SEND: return n == 0;
        case XCAN_V2_FW_STATUS:
            return n == 16 && p[0] <= 5 && p[1] <= 6 && zero(p + 2, 2);
        case XCAN_V2_FW_BEGIN: case XCAN_V2_FW_WRITE:
        case XCAN_V2_FW_FINISH: case XCAN_V2_FW_ABORT:
        case XCAN_V2_FW_REBOOT: return n == 0;
        default: return true;
        }
    }
    switch (m->opcode) {
    case XCAN_V2_FRAMES: {
        if (n < 8 || !u32(p) || !u16(p + 4) || !zero(p + 6, 2)) { return false; }
        size_t pos = 8;
        for (unsigned int i = 0; i < u16(p + 4); ++i) {
            size_t size = frame(p + pos, n - pos, false);
            if (!size) { return false; }
            pos += size;
        }
        return pos == n;
    }
    case XCAN_V2_STATE: return state(p, n);
    case XCAN_V2_TX_RESULT:
        return n == 16 && u32(p) != 0 && u16(p + 4) <= 3 && zero(p + 6, 2);
    default: return true; /* Unknown event remains framed; host may skip and account sequence. */
    }
}

static bool header(const uint8_t *p, struct xcan_v2_message *m)
{
    if (memcmp(p, "XCAN", 4) || p[4] != 2) { return false; }
    m->kind = p[5]; m->opcode = u16(p + 6); m->length = u16(p + 8);
    m->status = u16(p + 10); m->id = u32(p + 12); m->session = u32(p + 16);
    m->sequence = u32(p + 20);
    return envelope(m);
}

size_t xcan_v2_encode(const struct xcan_v2_message *m, uint8_t *wire, size_t capacity)
{
    if (!xcan_v2_valid(m) || capacity < XCAN_V2_HEADER + m->length) { return 0; }
    memcpy(wire, "XCAN", 4); wire[4] = 2; wire[5] = m->kind;
    put(wire + 6, m->opcode, 2); put(wire + 8, m->length, 2); put(wire + 10, m->status, 2);
    put(wire + 12, m->id, 4); put(wire + 16, m->session, 4); put(wire + 20, m->sequence, 4);
    memcpy(wire + XCAN_V2_HEADER, m->payload, m->length);
    return XCAN_V2_HEADER + m->length;
}

bool xcan_v2_decode(const uint8_t *wire, size_t n, struct xcan_v2_message *m)
{
    if (n < XCAN_V2_HEADER || !header(wire, m) || n != XCAN_V2_HEADER + m->length) { return false; }
    memcpy(m->payload, wire + XCAN_V2_HEADER, m->length);
    return xcan_v2_valid(m);
}

int xcan_v2_feed(struct xcan_v2_decoder *d, const uint8_t *data, size_t n,
                 size_t *consumed, struct xcan_v2_message *m)
{
    *consumed = 0;
    if (d->failed) { return -1; }
    while (*consumed < n) {
        size_t target = XCAN_V2_HEADER;
        if (d->used >= XCAN_V2_HEADER) { target += u16(d->bytes + 8); }
        size_t take = target - d->used;
        if (take > n - *consumed) { take = n - *consumed; }
        memcpy(d->bytes + d->used, data + *consumed, take);
        d->used += take; *consumed += take;
        if (d->used < XCAN_V2_HEADER) { continue; }
        if (!header(d->bytes, m)) { d->failed = true; return -1; }
        if (d->used == XCAN_V2_HEADER + m->length) {
            if (!xcan_v2_decode(d->bytes, d->used, m)) { d->failed = true; return -1; }
            d->used = 0;
            return 1;
        }
    }
    return 0;
}

bool xcan_v2_finish(struct xcan_v2_decoder *d)
{
    if (d->used) { d->failed = true; }
    return !d->failed;
}
```

## src/protocol_v2.h
```c
/* SPDX-License-Identifier: Apache-2.0 */
#ifndef XCAN_PROTOCOL_V2_H
#define XCAN_PROTOCOL_V2_H
#include <stdbool.h>
#include <stddef.h>
#include <stdint.h>

#define XCAN_V2_HEADER 24u
#define XCAN_V2_MAX_MESSAGE 544u
#define XCAN_V2_MAX_PAYLOAD (XCAN_V2_MAX_MESSAGE - XCAN_V2_HEADER)
#define XCAN_V2_REQUEST 1u
#define XCAN_V2_RESPONSE 2u
#define XCAN_V2_EVENT 3u
#define XCAN_V2_HELLO 1u
#define XCAN_V2_STATUS 2u
#define XCAN_V2_CONFIGURE 0x10u
#define XCAN_V2_START 0x11u
#define XCAN_V2_STOP 0x12u
#define XCAN_V2_SEND 0x13u
#define XCAN_V2_FW_BEGIN 0x20u
#define XCAN_V2_FW_STATUS 0x21u
#define XCAN_V2_FW_WRITE 0x22u
#define XCAN_V2_FW_FINISH 0x23u
#define XCAN_V2_FW_ABORT 0x24u
#define XCAN_V2_FW_REBOOT 0x25u
#define XCAN_V2_FRAMES 0x8001u
#define XCAN_V2_STATE 0x8002u
#define XCAN_V2_TX_RESULT 0x8003u

struct xcan_v2_message {
    uint8_t kind;
    uint16_t opcode, status, length;
    uint32_t id, session, sequence;
    uint8_t payload[XCAN_V2_MAX_PAYLOAD];
};

/* Caller owns storage. No packed structs, allocation or hardware access. */
struct xcan_v2_decoder {
    uint8_t bytes[XCAN_V2_MAX_MESSAGE];
    size_t used;
    bool failed;
};

struct xcan_v2_can_frame {
    uint16_t flags;
    uint32_t id, sequence;
    uint64_t timestamp_us;
    uint8_t dlc, length, data[64];
};
size_t xcan_v2_frame_encode(const struct xcan_v2_can_frame *frame, bool tx,
                            uint8_t *wire, size_t capacity);
/* Returns the consumed record size, or 0; permits more records after this one. */
size_t xcan_v2_frame_decode(const uint8_t *wire, size_t length, bool tx,
                            struct xcan_v2_can_frame *frame);

bool xcan_v2_valid(const struct xcan_v2_message *message);
/* Encode returns wire length, or 0 on invalid input / insufficient capacity. */
size_t xcan_v2_encode(const struct xcan_v2_message *message, uint8_t *wire, size_t capacity);
bool xcan_v2_decode(const uint8_t *wire, size_t length, struct xcan_v2_message *message);
/* One message per call: 1=ready, 0=partial, -1=latched failure.
 * Always advance by consumed; pass remaining input again for coalesced messages.
 * Zero-initialize once per new USB session; never reset just to skip bad bytes. */
int xcan_v2_feed(struct xcan_v2_decoder *decoder, const uint8_t *data, size_t length,
                 size_t *consumed, struct xcan_v2_message *message);
/* Call at EOF/disconnect. Truncation latches failure. */
bool xcan_v2_finish(struct xcan_v2_decoder *decoder);
#endif
```

## src/usb.c
```c
/* SPDX-License-Identifier: Apache-2.0 */
#include "usbd_core.h"
#include "app.h"
#include "fw_update.h"
#include "protocol.h"
#include "protocol_v2.h"
#include <string.h>

static const uint8_t device[] = {18,1,0x10,2,0,0,0,64,0xca,0xc0,0x13,3,0,1,1,2,3,1};
static const uint8_t config[] = {
    9,2,32,0,1,1,4,0x80,50, 9,4,0,0,2,0xff,0,0,0,
    7,5,1,2,64,0,0, 7,5,0x81,2,64,0,0
};
static const uint8_t bos_bytes[] = {
    5,15,33,0,1, 28,16,5,0,
    0xdf,0x60,0xdd,0xd8,0x89,0x45,0xc7,0x4c,0x9c,0xd2,0x65,0x9d,0x9e,0x64,0x8a,0x9f,
    0,0,0,0x0a,162,0,2,0
};
#include "msos_bytes.h"
static const struct usb_bos_descriptor bos = {bos_bytes, sizeof(bos_bytes)};
static char serial[25];
static const uint8_t *device_desc(uint8_t speed) { return device; }
static const uint8_t *config_desc(uint8_t speed) { return config; }
static const char *string_desc(uint8_t speed, uint8_t index)
{
    static const char lang[] = {9,4};
    const char *strings[] = {lang, "X-CAN", "X-CAN bringup", serial, "Vendor USB"};
    return index < 5 ? strings[index] : NULL;
}
static const struct usb_descriptor descriptors = {
    .device_descriptor_callback = device_desc,
    .config_descriptor_callback = config_desc,
    .string_descriptor_callback = string_desc,
    .bos_descriptor = &bos,
};
static int vendor(uint8_t busid, struct usb_setup_packet *s, uint8_t **data, uint32_t *len)
{
    static const uint8_t version[] = {'X','C','A','N',2,0,0x20,0x02};
    if (s->bmRequestType != 0xc0 || s->wValue != 0) return -1;
    if (s->bRequest == 2 && s->wIndex == 7) {
        *data = (uint8_t *)msos_bytes; *len = sizeof(msos_bytes); return 0;
    }
    if (s->bRequest == 3 && s->wIndex == 0) {
        *data = (uint8_t *)version; *len = sizeof(version); return 0;
    }
    return -1;
}
static struct usbd_interface interface = {.vendor_handler = vendor};
static uint8_t packet[64] __attribute__((aligned(4)));
static uint8_t request[XCAN_V2_MAX_MESSAGE] __attribute__((aligned(4)));
static uint8_t work_request[XCAN_V2_MAX_MESSAGE] __attribute__((aligned(4)));
static uint8_t response[XCAN_V2_MAX_MESSAGE] __attribute__((aligned(4)));
static struct xcan_v2_message v2_request, v2_response;
static unsigned received, expected;
static uint32_t session_generation, session, last_request_id;
static volatile uint32_t connection_generation;
static volatile bool enabled, ready, reboot_after_tx;

static uint16_t get16(const uint8_t *p)
{ return (uint16_t)p[0] | (uint16_t)p[1] << 8; }
static void put16(uint8_t *p, uint16_t value)
{ p[0] = (uint8_t)value; p[1] = (uint8_t)(value >> 8); }
static void put32(uint8_t *p, uint32_t value)
{ for (unsigned i = 0; i < 4; ++i) p[i] = (uint8_t)(value >> (8 * i)); }

static void arm_out(void)
{
    if (usbd_ep_start_read(0, 1, packet, sizeof(packet))) {
        enabled = false; received = expected = 0;
    }
}

static bool set_expected(void)
{
    if (expected || received < 5) return true;
    if (request[4] == 1) { expected = 64; return true; }
    if (request[4] != 2) { expected = 64; return true; }
    if (received < XCAN_V2_HEADER) return true;
    uint16_t length = get16(request + 8);
    if (length > XCAN_V2_MAX_PAYLOAD) return false;
    expected = XCAN_V2_HEADER + length;
    return true;
}

static void out_done(uint8_t busid, uint8_t ep, uint32_t n)
{
    if (!enabled || ready || !usb_device_is_configured(0)) return;
    if (n > sizeof(request) - received || (expected && n > expected - received)) {
        memset(request, 0, 64); request[4] = 1; request[5] = 0xff;
        received = expected = 64;
    } else {
        memcpy(request + received, packet, n); received += n;
        if (!set_expected()) { enabled = false; received = expected = 0; return; }
        if (!expected || received < expected) { arm_out(); return; }
        if (received != expected) { enabled = false; received = expected = 0; return; }
    }
    ready = true;
    usb_wake();
}

static void in_done(uint8_t busid, uint8_t ep, uint32_t n)
{
    if (reboot_after_tx) { reboot_after_tx = false; xcan_reboot(); }
    if (enabled && usb_device_is_configured(0)) arm_out();
}
static struct usbd_endpoint out_ep = {.ep_addr = 1, .ep_cb = out_done};
static struct usbd_endpoint in_ep = {.ep_addr = 0x81, .ep_cb = in_done};
static void event(uint8_t busid, uint8_t e)
{
    if (e == USBD_EVENT_RESET || e == USBD_EVENT_DISCONNECTED || e == USBD_EVENT_ERROR) {
        connection_generation++;
        enabled = ready = reboot_after_tx = false;
        received = expected = session = last_request_id = 0;
    } else if (e == USBD_EVENT_CONFIGURED) {
        connection_generation++;
        received = expected = session = last_request_id = 0;
        ready = reboot_after_tx = false; enabled = true; arm_out();
    }
}

static uint16_t fw_status(int result)
{
    if (result == 0) return 0;
    switch (-result) {
    case XCAN_FW_ERROR_ARGUMENT: case XCAN_FW_ERROR_MAGIC: case XCAN_FW_ERROR_HASH: return 1;
    case XCAN_FW_ERROR_STATE: return 3;
    default: return 6;
    }
}

static uint32_t get32(const uint8_t *p)
{
    return (uint32_t)p[0] | (uint32_t)p[1] << 8 |
           (uint32_t)p[2] << 16 | (uint32_t)p[3] << 24;
}

static bool prepare_v2(void)
{
    memset(&v2_response, 0, sizeof(v2_response));
    v2_response.kind = XCAN_V2_RESPONSE;
    v2_response.opcode = v2_request.opcode;
    v2_response.id = v2_request.id;
    v2_response.session = v2_request.session;
    if (v2_request.opcode == XCAN_V2_HELLO) {
        if (session != 0) { v2_response.status = 3; return false; }
        session = ++session_generation;
        if (session == 0) session = ++session_generation;
        last_request_id = v2_request.id;
        v2_response.session = session;
        v2_response.length = 16;
        put32(v2_response.payload, 1u << 4);
        put16(v2_response.payload + 4, XCAN_V2_MAX_MESSAGE);
        v2_response.payload[6] = 1;
        v2_response.payload[7] = 2;
        put32(v2_response.payload + 8, 1000000);
        return false;
    }
    if (session == 0 || v2_request.session != session) {
        v2_response.status = 5; return false;
    }
    if (v2_request.id <= last_request_id) {
        v2_response.status = 3; return false;
    }
    last_request_id = v2_request.id;
    return true;
}

static bool dispatch_v2(void)
{
    bool reboot = false;
    switch (v2_request.opcode) {
    case XCAN_V2_FW_BEGIN:
        if (!xcan_update_ready()) v2_response.status = 4;
        else v2_response.status = fw_status(xcan_fw_begin(get32(v2_request.payload),
                                                          v2_request.payload + 4));
        break;
    case XCAN_V2_FW_STATUS: {
        xcan_fw_step();
        struct xcan_fw_status status;
        xcan_fw_get_status(&status);
        v2_response.length = 16;
        v2_response.payload[0] = status.state;
        v2_response.payload[1] = status.error;
        put32(v2_response.payload + 4, status.image_size);
        put32(v2_response.payload + 8, status.next_offset);
        put32(v2_response.payload + 12, status.erase_offset);
        break;
    }
    case XCAN_V2_FW_WRITE: {
        struct xcan_fw_status status;
        xcan_fw_get_status(&status);
        if (status.state == XCAN_FW_ERASING) { v2_response.status = 4; break; }
        v2_response.status = fw_status(xcan_fw_write(
            get32(v2_request.payload), v2_request.payload + 8,
            get16(v2_request.payload + 4)));
        break;
    }
    case XCAN_V2_FW_FINISH:
        v2_response.status = fw_status(xcan_fw_finish());
        break;
    case XCAN_V2_FW_ABORT:
        v2_response.status = fw_status(xcan_fw_abort());
        break;
    case XCAN_V2_FW_REBOOT:
        if (!xcan_fw_complete()) v2_response.status = 3;
        else reboot = true;
        break;
    default:
        v2_response.status = 2;
        break;
    }
    return reboot;
}

void usb_work(void)
{
    unsigned request_length;
    uint32_t generation;
    usb_lock();
    if (!enabled || !ready || !usb_device_is_configured(0)) {
        usb_unlock();
        return;
    }
    ready = false;
    request_length = received;
    memcpy(work_request, request, request_length);
    received = expected = 0;
    generation = connection_generation;
    usb_unlock();

    unsigned response_length = 0;
    bool reboot = false;
    if (work_request[4] == 1) {
        xcan_reply(work_request, response, 144000000, board_id(), uptime_ms(), termination_get());
        response_length = 64;
    } else if (xcan_v2_decode(work_request, request_length, &v2_request)) {
        usb_lock();
        bool connected = enabled && usb_device_is_configured(0) &&
                         generation == connection_generation;
        bool execute = connected && prepare_v2();
        usb_unlock();
        if (!connected) return;
        if (execute) reboot = dispatch_v2();
        response_length = xcan_v2_encode(&v2_response, response, sizeof(response));
    }

    usb_lock();
    if (!response_length) {
        if (generation == connection_generation) enabled = false;
    } else if (enabled && usb_device_is_configured(0) &&
               generation == connection_generation) {
        reboot_after_tx = reboot;
        if (usbd_ep_start_write(0, 0x81, response, response_length)) {
            reboot_after_tx = false;
            enabled = false;
        }
    }
    usb_unlock();
}

int usb_init(const uint32_t uid[3])
{
    static const char hex[] = "0123456789ABCDEF";
    for (unsigned i = 0; i < 24; i++) serial[i] = hex[(uid[2-i/8] >> (28 - (i%8)*4)) & 15];
    serial[24] = 0;
    xcan_fw_reset();
    usbd_desc_register(0, &descriptors);
    usbd_add_interface(0, &interface);
    usbd_add_endpoint(0, &out_ep); usbd_add_endpoint(0, &in_ep);
    return usbd_initialize(0, 0x40005c00, event);
}
```

## src/usb_config.h
```c
#pragma once
#define CONFIG_USB_PRINTF(...) ((void)0)
#define CONFIG_USB_DBG_LEVEL (-1)
#define CONFIG_USB_ALIGN_SIZE 4
#define CONFIG_USBDEV_REQUEST_BUFFER_LEN 256
#define CONFIG_USBDEV_MAX_BUS 1
#define CONFIG_USBDEV_FSDEV_PMA_ACCESS 1
/* Only 320 bytes needed: BTABLE + EP0 OUT/IN + bulk OUT/IN. */
#define CONFIG_USB_FSDEV_RAM_SIZE 512
#define USB_NOCACHE_RAM_SECTION
```
